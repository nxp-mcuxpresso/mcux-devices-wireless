## KW/KW43B43ZC2/drivers/Kconfig
```kconfig
# Copyright 2026 NXP
#
# SPDX-License-Identifier: BSD-3-Clause

menu "Device specific drivers configuration"
     rsource "../../KW43B43ZC7/drivers/Kconfig_clock"
     rsource "../../KW43B43ZC7/drivers/Kconfig_romapi"
     rsource "../../KW43B43ZC7/drivers/Kconfig_memory"
endmenu
```

## KW/KW47B42Z83/cm33_core0/Kconfig
```kconfig
# Copyright 2024 NXP
# All rights reserved.
#
# SPDX-License-Identifier: BSD-3-Clause

config MCUX_HW_DEVICE_KW47B42Z83_CORE_ID_cm33_core0
    bool
    default y

rsource "Kconfig.chip"
```

## KW/KW47B42ZB2/cm33_core0/Kconfig
```kconfig
# Copyright 2024 NXP
# All rights reserved.
#
# SPDX-License-Identifier: BSD-3-Clause

config MCUX_HW_DEVICE_KW47B42ZB2_CORE_ID_cm33_core0
    bool
    default y

rsource "Kconfig.chip"
```

## KW/KW47Z420B2/Kconfig.chip
```kconfig
# device related

config MCUX_HW_DEVICE_ID_KW47Z420B2xxxA
    bool

choice
    prompt "Device KW47Z420B2 Part"
    config MCUX_HW_DEVICE_PART_KW47Z420B2AFTA
    bool "Device part KW47Z420B2AFTA"
    select MCUX_HW_DEVICE_ID_KW47Z420B2xxxA
endchoice

config MCUX_HW_DEVICE_ID
    string
    default "KW47Z420B2xxxA" if MCUX_HW_DEVICE_ID_KW47Z420B2xxxA

config MCUX_HW_DEVICE_PART
    string
    default "KW47Z420B2AFTA" if MCUX_HW_DEVICE_PART_KW47Z420B2AFTA

# ip information
config MCUX_HW_IP_DriverType_ATX
    bool
    default y
    depends on MCUX_HW_DEVICE_ID_KW47Z420B2xxxA

config MCUX_HW_IP_DriverType_AXBS
    bool
    default y
    depends on MCUX_HW_DEVICE_ID_KW47Z420B2xxxA

config MCUX_HW_IP_DriverType_BTRTU1
    bool
    default y
    depends on MCUX_HW_DEVICE_ID_KW47Z420B2xxxA

config MCUX_HW_IP_DriverType_BTU2_REG
    bool
    default y
    depends on MCUX_HW_DEVICE_ID_KW47Z420B2xxxA

config MCUX_HW_IP_DriverType_CCM32K
    bool
    default y
    depends on MCUX_HW_DEVICE_ID_KW47Z420B2xxxA

config MCUX_HW_IP_DriverType_CMC
    bool
    default y
    depends on MCUX_HW_DEVICE_ID_KW47Z420B2xxxA

config MCUX_HW_IP_DriverType_CRC
    bool
    default y
    depends on MCUX_HW_DEVICE_ID_KW47Z420B2xxxA

config MCUX_HW_IP_DriverType_DMA3
    bool
    default y
    depends on MCUX_HW_DEVICE_ID_KW47Z420B2xxxA

config MCUX_HW_IP_DriverType_ELEMU
    bool
    default y
    depends on MCUX_HW_DEVICE_ID_KW47Z420B2xxxA

config MCUX_HW_IP_DriverType_EWM
    bool
    default y
    depends on MCUX_HW_DEVICE_ID_KW47Z420B2xxxA

config MCUX_HW_IP_DriverType_FLASH_K4
    bool
    default y
    depends on MCUX_HW_DEVICE_ID_KW47Z420B2xxxA

config MCUX_HW_IP_DriverType_FLEXIO
    bool
    default y
    depends on MCUX_HW_DEVICE_ID_KW47Z420B2xxxA

config MCUX_HW_IP_DriverType_FMC
    bool
    default y
    depends on MCUX_HW_DEVICE_ID_KW47Z420B2xxxA

config MCUX_HW_IP_DriverType_GPIO
    bool
    default y
    depends on MCUX_HW_DEVICE_ID_KW47Z420B2xxxA

config MCUX_HW_IP_DriverType_I3C
    bool
    default y
    depends on MCUX_HW_DEVICE_ID_KW47Z420B2xxxA

config MCUX_HW_IP_DriverType_LPADC
    bool
    default y
    depends on MCUX_HW_DEVICE_ID_KW47Z420B2xxxA

config MCUX_HW_IP_DriverType_LPCMP
    bool
    default y
    depends on MCUX_HW_DEVICE_ID_KW47Z420B2xxxA

config MCUX_HW_IP_DriverType_LPI2C
    bool
    default y
    depends on MCUX_HW_DEVICE_ID_KW47Z420B2xxxA

config MCUX_HW_IP_DriverType_LPIT
    bool
    default y
    depends on MCUX_HW_DEVICE_ID_KW47Z420B2xxxA

config MCUX_HW_IP_DriverType_LPSPI
    bool
    default y
    depends on MCUX_HW_DEVICE_ID_KW47Z420B2xxxA

config MCUX_HW_IP_DriverType_LPTMR
    bool
    default y
    depends on MCUX_HW_DEVICE_ID_KW47Z420B2xxxA

config MCUX_HW_IP_DriverType_LPUART
    bool
    default y
    depends on MCUX_HW_DEVICE_ID_KW47Z420B2xxxA

config MCUX_HW_IP_DriverType_LTC
    bool
    default y
    depends on MCUX_HW_DEVICE_ID_KW47Z420B2xxxA

config MCUX_HW_IP_DriverType_MCM
    bool
    default y
    depends on MCUX_HW_DEVICE_ID_KW47Z420B2xxxA

config MCUX_HW_IP_DriverType_MRCC
    bool
    default y
    depends on MCUX_HW_DEVICE_ID_KW47Z420B2xxxA

config MCUX_HW_IP_DriverType_MSCM
    bool
    default y
    depends on MCUX_HW_DEVICE_ID_KW47Z420B2xxxA

config MCUX_HW_IP_DriverType_MSF1
    bool
    default y
    depends on MCUX_HW_DEVICE_ID_KW47Z420B2xxxA

config MCUX_HW_IP_DriverType_PORT
    bool
    default y
    depends on MCUX_HW_DEVICE_ID_KW47Z420B2xxxA

config MCUX_HW_IP_DriverType_REGFILE
    bool
    default y
    depends on MCUX_HW_DEVICE_ID_KW47Z420B2xxxA

config MCUX_HW_IP_DriverType_SCG
    bool
    default y
    depends on MCUX_HW_DEVICE_ID_KW47Z420B2xxxA

config MCUX_HW_IP_DriverType_SFA
    bool
    default y
    depends on MCUX_HW_DEVICE_ID_KW47Z420B2xxxA

config MCUX_HW_IP_DriverType_SEMA42
    bool
    default y
    depends on MCUX_HW_DEVICE_ID_KW47Z420B2xxxA

config MCUX_HW_IP_DriverType_SMSCM
    bool
    default y
    depends on MCUX_HW_DEVICE_ID_KW47Z420B2xxxA

config MCUX_HW_IP_DriverType_SPC
    bool
    default y
    depends on MCUX_HW_DEVICE_ID_KW47Z420B2xxxA

config MCUX_HW_IP_DriverType_SRTC
    bool
    default y
    depends on MCUX_HW_DEVICE_ID_KW47Z420B2xxxA

config MCUX_HW_IP_DriverType_SYSPM
    bool
    default y
    depends on MCUX_HW_DEVICE_ID_KW47Z420B2xxxA

config MCUX_HW_IP_DriverType_TPIU
    bool
    default y
    depends on MCUX_HW_DEVICE_ID_KW47Z420B2xxxA

config MCUX_HW_IP_DriverType_TPM
    bool
    default y
    depends on MCUX_HW_DEVICE_ID_KW47Z420B2xxxA

config MCUX_HW_IP_DriverType_TRDC
    bool
    default y
    depends on MCUX_HW_DEVICE_ID_KW47Z420B2xxxA

config MCUX_HW_IP_DriverType_TRGMUX
    bool
    default y
    depends on MCUX_HW_DEVICE_ID_KW47Z420B2xxxA

config MCUX_HW_IP_DriverType_TSTMR
    bool
    default y
    depends on MCUX_HW_DEVICE_ID_KW47Z420B2xxxA

config MCUX_HW_IP_DriverType_VBAT
    bool
    default y
    depends on MCUX_HW_DEVICE_ID_KW47Z420B2xxxA

config MCUX_HW_IP_DriverType_VREF_1
    bool
    default y
    depends on MCUX_HW_DEVICE_ID_KW47Z420B2xxxA

config MCUX_HW_IP_DriverType_WDOG32
    bool
    default y
    depends on MCUX_HW_DEVICE_ID_KW47Z420B2xxxA

config MCUX_HW_IP_DriverType_WUU
    bool
    default y
    depends on MCUX_HW_DEVICE_ID_KW47Z420B2xxxA
```

## RW/RW610/drivers/Kconfig
```kconfig
# Copyright 2024 NXP
#  
#
# SPDX-License-Identifier: BSD-3-Clause

menu "Device specific drivers configuration"

    config MCUX_COMPONENT_driver.clock
         bool "clock"
         default y

    config MCUX_COMPONENT_driver.i2s_bridge
         bool "i2s_bridge"
         default y

    config MCUX_COMPONENT_driver.inputmux_connections
         bool "inputmux_connections"
         default y

    config MCUX_COMPONENT_driver.io_mux
         bool "io_mux"
         default y

    config MCUX_COMPONENT_driver.iped_rw61x
         bool "iped"
         default y

    config MCUX_COMPONENT_driver.memory
         bool "memory"
         default y

    config MCUX_COMPONENT_driver.ocotp_rw61x
         bool "ocotp"
         default y

    config MCUX_COMPONENT_driver.power
         bool "power"
         default y

    config MCUX_COMPONENT_driver.reset
         bool "reset"
         default y

    config MCUX_COMPONENT_driver.romapi
         bool "romapi"

endmenu
```
